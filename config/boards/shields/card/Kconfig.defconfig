## config/boards/shields/card/Kconfig.defconfig
```kconfig
# Copyright (c) 2020 The ZMK Contributors
# SPDX-License-Identifier: MIT

config ZMK_BLE
	default y

config ZMK_USB
	default y

CONFIG_BT_GATT_ENFORCE_SUBSCRIPTION=n

if SHIELD_CARD_LEFT || SHIELD_CARD_RIGHT

config ZMK_KEYBOARD_NAME
	default "The Card"

endif


if SHIELD_CARD_RIGHT

config ZMK_SPLIT
	default y

endif


if SHIELD_PIANO_NORM_LEFT

config ZMK_SPLIT
	default y

config ZMK_SPLIT_BLE_ROLE_CENTRAL
	default y

endif
```

## config/boards/shields/card/Kconfig.shield
```kconfig
config SHIELD_CARD_LEFT
    def_bool $(shields_list_contains, card_left)

config SHIELD_CARD_RIGHT
    def_bool $(shields_list_contains, card_right)

config SHIELD_PUNI
	def_bool $(shields_list_contains,puni)
```
